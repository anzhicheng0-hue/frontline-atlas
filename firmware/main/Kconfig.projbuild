## firmware/main/Kconfig.projbuild
```kconfig
menu "Frontline web server"
    config FRONTLINE_WIFI_SSID
        string "Router Wi-Fi SSID (empty means AP only)"
        default ""
    config FRONTLINE_WIFI_PASSWORD
        string "Router Wi-Fi password"
        default ""
    config FRONTLINE_AP_SSID
        string "ESP32 fallback hotspot name"
        default "Frontline-ESP32"
    config FRONTLINE_AP_PASSWORD
        string "ESP32 hotspot password (8-63 characters)"
        default "frontline2026"
endmenu
```

## firmware/sdkconfig.defaults
```kconfig
CONFIG_IDF_TARGET="esp32"
CONFIG_ESPTOOLPY_FLASHSIZE_4MB=y
CONFIG_ESP_MAIN_TASK_STACK_SIZE=6144
CONFIG_HTTPD_MAX_REQ_HDR_LEN=2048
CONFIG_HTTPD_MAX_URI_LEN=512
CONFIG_LWIP_MAX_SOCKETS=12
```
